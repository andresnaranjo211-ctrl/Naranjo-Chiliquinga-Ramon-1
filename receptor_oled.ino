#include <SPI.h>
#include <mcp_can.h>
#include <Wire.h>
#include <Adafruit_GFX.h>
#include <Adafruit_SSD1306.h>

#define CAN_CS 10
#define SCREEN_WIDTH 128
#define SCREEN_HEIGHT 64
#define OLED_ADDR 0x3C

Adafruit_SSD1306 display(SCREEN_WIDTH, SCREEN_HEIGHT, &Wire, -1);
#define LOGO_WIDTH    75
#define LOGO_HEIGHT   52

const unsigned char PROGMEM logo[] = {
0xff, 0xff, 0xff, 0xff, 0xff, 0xff, 0xff, 0xff, 0xff, 0xe0, 0xff, 0xff, 0xff, 0xff, 0xff, 0xff, 
0xff, 0xff, 0xff, 0xe0, 0xff, 0xff, 0xff, 0xff, 0xff, 0xff, 0xff, 0xff, 0xff, 0xe0, 0xff, 0xff, 
0xff, 0xff, 0xff, 0xff, 0xff, 0xff, 0xff, 0xe0, 0xff, 0xff, 0xff, 0xff, 0xff, 0xff, 0xff, 0xff, 
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0xff, 0xff, 0xff, 0xff, 0xff, 0xff, 0xff, 0xe0
};

const unsigned char PROGMEM derrape[] = {
0x00, 0x00, 0x00, 0x00, 0x00, 0x00, 0x00, 0x00, 0x00, 0x00, 0x00, 0x00, 0x00, 0x00, 0x00, 0x00, 
0x00, 0x00, 0x00, 0x00, 0x00, 0x00, 0x00, 0x00, 0x00, 0x00, 0x00, 0x00, 0x00, 0x00, 0x00, 0x00, 
0x00, 0x00, 0x00, 0x00, 0x00, 0x00, 0x00, 0x00, 0x00, 0x00, 0x00, 0x00, 0x00, 0x00, 0x00, 0x00, 
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0x00, 0x00, 0x00, 0x00, 0x00, 0x00, 0x00, 0x00
};

const unsigned char PROGMEM COLISION[] = {
0xff, 0xff, 0xff, 0xff, 0xff, 0xff, 0xff, 0xff, 0xff, 0xe0, 0xff, 0xff, 0xff, 0xff, 0xff, 0xff, 
0xff, 0xff, 0xff, 0xe0, 0xff, 0xff, 0xff, 0xff, 0xff, 0xff, 0xff, 0xff, 0xff, 0xe0, 0xff, 0xff, 
0xff, 0xff, 0xff, 0xff, 0xff, 0xff, 0xff, 0xe0, 0xff, 0xff, 0xff, 0xff, 0xff, 0xff, 0xff, 0xff, 
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0xff, 0xff, 0xff, 0xff, 0xff, 0xff, 0xff, 0xe0
};

MCP_CAN CAN(CAN_CS);

// LEDs
const int LED_SOUND = 8;
const int LED_VIB   = 9;

void setup() {
  Serial.begin(115200);

  pinMode(LED_SOUND, OUTPUT);
  pinMode(LED_VIB, OUTPUT);

  display.begin(SSD1306_SWITCHCAPVCC, OLED_ADDR);
  display.clearDisplay();
  display.setTextColor(SSD1306_WHITE);

  while (CAN_OK != CAN.begin(MCP_ANY, CAN_250KBPS, MCP_8MHZ)) {
    Serial.println("Error iniciando CAN...");
    delay(500);
  }

  CAN.setMode(MCP_NORMAL);

  Serial.println("Receptor CAN iniciado correctamente");
}

void loop() {

  unsigned long rxId;
  unsigned char len = 0;
  unsigned char buf[8];

  if (CAN_MSGAVAIL == CAN.checkReceive()) {

    CAN.readMsgBuf(&rxId, &len, buf);  // ← ESTA ES LA FORMA CORRECTA

    if (rxId == 0x100 && len >= 2) {

      bool soundState = buf[0];
      bool vibState   = buf[1];

      digitalWrite(LED_SOUND, soundState ? HIGH : LOW);
      digitalWrite(LED_VIB, !vibState ? HIGH : LOW);
      delay (50);

      Serial.print("Recibido -> Sonido: ");
      Serial.print(soundState);
      Serial.print(" | Vibracion: ");
      Serial.println(vibState);

      if (soundState ==LOW && vibState == HIGH){
        display.clearDisplay(); 
  display.setTextSize(3);
  display.setTextColor(WHITE);
  display.setCursor(5,0);
  display.println("Normal");
  display.display();
      }
      else if (soundState ==HIGH && vibState == HIGH){

        display.clearDisplay(); 
  display.setTextSize(1);
  display.setTextColor(WHITE);
  display.setCursor(18,0);
  display.println("Sonido fuerte");
  display.display();


  display.drawLine(0, 10, 128, 10, WHITE);
  display.display();


  display.drawBitmap( (display.width() - LOGO_WIDTH ) / 2,((display.height()- LOGO_HEIGHT) / 2 )+7, logo, LOGO_WIDTH, LOGO_HEIGHT, WHITE);
  display.display();
  delay(500);
    }
    else if (soundState == LOW && vibState == LOW){

        display.clearDisplay(); 
  display.setTextSize(1);
  display.setTextColor(WHITE);
  display.setCursor(18,0);
  display.println("Golpe fuerte");
  display.display();


  display.drawLine(0, 10, 128, 10, WHITE);
  display.display();


  display.drawBitmap( (display.width() - LOGO_WIDTH ) / 2,((display.height()- LOGO_HEIGHT) / 2 )+7, derrape, LOGO_WIDTH, LOGO_HEIGHT, WHITE);
  display.display();
  delay(1000);
    }
    else if (soundState == HIGH && vibState == LOW){

        display.clearDisplay(); 
  display.setTextSize(1);
  display.setTextColor(WHITE);
  display.setCursor(18,0);
  display.println("Posible Colision");
  display.display();


  display.drawLine(0, 10, 128, 10, WHITE);
  display.display();


  display.drawBitmap( (display.width() - LOGO_WIDTH ) / 2,((display.height()- LOGO_HEIGHT) / 2 )+7, COLISION, LOGO_WIDTH, LOGO_HEIGHT, WHITE);
  display.display();
  delay(2000);

    }
    }
  }
}
